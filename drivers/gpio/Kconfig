## drivers/video/omap2/omaplfb/Kconfig
```kconfig
config OMAPLFB
        bool "Interface between display and PowerVR graphics driver"
        depends on OMAP2_DSS && DSSCOMP
	default y
	help
	  Support for in-kernel omaplfb.
	  This is used by PVR kernel module.
```

## drivers/virtio/Kconfig
```kconfig
# Virtio always gets selected by whoever wants it.
config VIRTIO
	tristate

# Similarly the virtio ring implementation.
config VIRTIO_RING
	tristate
	depends on VIRTIO

config VIRTIO_BALLOON
	tristate "Virtio balloon driver (EXPERIMENTAL)"
	select VIRTIO
	select VIRTIO_RING
	---help---
	 This driver supports increasing and decreasing the amount
	 of memory within a KVM guest.

	 If unsure, say M.
```

## sound/Kconfig
```kconfig
menuconfig SOUND
	tristate "Sound card support"
	depends on HAS_IOMEM
	help
	  If your device have sound say Y.

	  You want to read the Sound-HOWTO, available from
	  <http://www.tldp.org/docs.html#howto>. General information about
	  the modular sound system is contained in the files
	  <file:Documentation/sound/oss/Introduction>.  The file
	  <file:Documentation/sound/oss/README.OSS> contains some slightly
	  outdated but still useful information as well.  Newer sound
	  driver documentation is found in <file:Documentation/sound/alsa/*>.

if SOUND

config SOUND_OSS_CORE
	bool
	default n

config SOUND_OSS_CORE_PRECLAIM
	bool "Preclaim OSS device numbers"
	depends on SOUND_OSS_CORE
	default y
	help
	  With this option enabled, the kernel will claim all OSS device
	  numbers if any OSS support (native or emulation) is enabled
	  whether the respective module is loaded or not and try to load the
	  appropriate module using sound-slot/service-* and char-major-*
	  module aliases when one of the device numbers is opened.  With
	  this option disabled, kernel will only claim actually in-use
	  device numbers and opening a missing device will generate only the
	  standard char-major-* aliases.

	  The only visible difference is use of additional module aliases
	  and whether OSS sound devices appear multiple times in
	  /proc/devices.  sound-slot/service-* module aliases are scheduled
	  to be removed (ie. PRECLAIM won't be available) and this option is
	  to make the transition easier.  This option can be overridden
	  during boot using the kernel parameter soundcore.preclaim_oss.

	  Disabling this allows alternative OSS implementations.

	  Please read Documentation/feature-removal-schedule.txt for
	  details.

	  If unsure, say Y.

if !M68K

menuconfig SND
	tristate "Advanced Linux Sound Architecture"
	help
	  Say 'Y' or 'M' to enable ALSA (Advanced Linux Sound Architecture),
	  the new base sound system.

	  For more information, see <http://www.alsa-project.org/>

if SND

source "sound/core/Kconfig"

source "sound/drivers/Kconfig"

source "sound/arm/Kconfig"

source "sound/usb/Kconfig"

source "sound/spi/Kconfig"

source "sound/soc/Kconfig"

endif # SND

endif # !M68K

endif # SOUND

# AC97_BUS is used from both sound and ucb1400
config AC97_BUS
	tristate
	help
	  This is used to avoid config and link hard dependencies between the
	  sound subsystem and other function drivers completely unrelated to
	  sound although they're sharing the AC97 bus. Concerned drivers
	  should "select" this.

config SND_TI_SOC_SOURCE
	tristate "TI modified Sound System"
	help
		Say 'Y' or 'M' to enable TI modified Sound System drivers.

config SND_OPEN_SOC_SOURCE
	tristate "Open Sound System"
	help
		Say 'Y' or 'M' to enable Open Sound System drivers.
```
