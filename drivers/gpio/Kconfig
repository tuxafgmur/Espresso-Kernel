## drivers/misc/Kconfig
```kconfig
#
# Misc strange devices
#

# This one has to live outside of the MISC_DEVICES conditional,
# because it may be selected by drivers/platform/x86/hp_accel.
config SENSORS_LIS3LV02D
	tristate
	depends on INPUT
	select INPUT_POLLDEV
	default n

menuconfig MISC_DEVICES
	bool "Misc devices"
	---help---
	  Say Y here to get to see options for device drivers from various
	  different categories. This option alone does not add any kernel code.

	  If you say N, all options in this submenu will be skipped and disabled.

if MISC_DEVICES

config AD525X_DPOT
	tristate "Analog Devices Digital Potentiometers"
	depends on (I2C || SPI) && SYSFS
	help
	  If you say yes here, you get support for the Analog Devices
	  AD5258, AD5259, AD5251, AD5252, AD5253, AD5254, AD5255
	  AD5160, AD5161, AD5162, AD5165, AD5200, AD5201, AD5203,
	  AD5204, AD5206, AD5207, AD5231, AD5232, AD5233, AD5235,
	  AD5260, AD5262, AD5263, AD5290, AD5291, AD5292, AD5293,
	  AD7376, AD8400, AD8402, AD8403, ADN2850, AD5241, AD5242,
	  AD5243, AD5245, AD5246, AD5247, AD5248, AD5280, AD5282,
	  ADN2860, AD5273, AD5171, AD5170, AD5172, AD5173, AD5270,
	  AD5271, AD5272, AD5274
	  digital potentiometer chips.

	  See Documentation/misc-devices/ad525x_dpot.txt for the
	  userspace interface.

	  This driver can also be built as a module.  If so, the module
	  will be called ad525x_dpot.

config AD525X_DPOT_I2C
	tristate "support I2C bus connection"
	depends on AD525X_DPOT && I2C
	help
	  Say Y here if you have a digital potentiometers hooked to an I2C bus.

	  To compile this driver as a module, choose M here: the
	  module will be called ad525x_dpot-i2c.

config AD525X_DPOT_SPI
	tristate "support SPI bus connection"
	depends on AD525X_DPOT && SPI_MASTER
	help
	  Say Y here if you have a digital potentiometers hooked to an SPI bus.

	  If unsure, say N (but it's safe to say "Y").

	  To compile this driver as a module, choose M here: the
	  module will be called ad525x_dpot-spi.

config ATMEL_PWM
	tristate "Atmel AT32/AT91 PWM support"
	depends on AVR32 || ARCH_AT91SAM9263 || ARCH_AT91SAM9RL || ARCH_AT91CAP9
	help
	  This option enables device driver support for the PWM channels
	  on certain Atmel processors.  Pulse Width Modulation is used for
	  purposes including software controlled power-efficient backlights
	  on LCD displays, motor control, and waveform generation.

config AB8500_PWM
	bool "AB8500 PWM support"
	depends on AB8500_CORE && ARCH_U8500
	select HAVE_PWM
	help
	  This driver exports functions to enable/disble/config/free Pulse
	  Width Modulation in the Analog Baseband Chip AB8500.
	  It is used by led and backlight driver to control the intensity.

config ICS932S401
	tristate "Integrated Circuits ICS932S401"
	depends on I2C && EXPERIMENTAL
	help
	  If you say yes here you get support for the Integrated Circuits
	  ICS932S401 clock control chips.

	  This driver can also be built as a module. If so, the module
	  will be called ics932s401.

config ATMEL_SSC
	tristate "Device driver for Atmel SSC peripheral"
	depends on AVR32 || ARCH_AT91
	---help---
	  This option enables device driver support for Atmel Synchronized
	  Serial Communication peripheral (SSC).

	  The SSC peripheral supports a wide variety of serial frame based
	  communications, i.e. I2S, SPI, etc.

	  If unsure, say N.

config ENCLOSURE_SERVICES
	tristate "Enclosure Services"
	default n
	help
	  Provides support for intelligent enclosures (bays which
	  contain storage devices).  You also need either a host
	  driver (SCSI/ATA) which supports enclosures
	  or a SCSI enclosure device (SES) to use these services.

config SAMSUNG_JACK
	bool "3.5MM ear jack driver for Samsung devices"
	depends on INPUT
	default n
	---help---
	 This is 3.5MM ear jack driver for Samsung devices.

	 If unsure, say N.

config APDS9802ALS
	tristate "Medfield Avago APDS9802 ALS Sensor module"
	depends on I2C
	help
	  If you say yes here you get support for the ALS APDS9802 ambient
	  light sensor.

	  This driver can also be built as a module.  If so, the module
	  will be called apds9802als.

config ISL29003
	tristate "Intersil ISL29003 ambient light sensor"
	depends on I2C && SYSFS
	help
	  If you say yes here you get support for the Intersil ISL29003
	  ambient light sensor.

	  This driver can also be built as a module.  If so, the module
	  will be called isl29003.

config ISL29020
	tristate "Intersil ISL29020 ambient light sensor"
	depends on I2C
	help
	  If you say yes here you get support for the Intersil ISL29020
	  ambient light sensor.

	  This driver can also be built as a module.  If so, the module
	  will be called isl29020.

config SENSORS_TSL2550
	tristate "Taos TSL2550 ambient light sensor"
	depends on I2C && SYSFS
	help
	  If you say yes here you get support for the Taos TSL2550
	  ambient light sensor.

	  This driver can also be built as a module.  If so, the module
	  will be called tsl2550.

config SENSORS_BH1780
	tristate "ROHM BH1780GLI ambient light sensor"
	depends on I2C && SYSFS
	help
	  If you say yes here you get support for the ROHM BH1780GLI
	  ambient light sensor.

	  This driver can also be built as a module.  If so, the module
	  will be called bh1780gli.

config SENSORS_BH1770
         tristate "BH1770GLC / SFH7770 combined ALS - Proximity sensor"
         depends on I2C
         ---help---
           Say Y here if you want to build a driver for BH1770GLC (ROHM) or
	   SFH7770 (Osram) combined ambient light and proximity sensor chip.

           To compile this driver as a module, choose M here: the
           module will be called bh1770glc. If unsure, say N here.

config SENSORS_APDS990X
	 tristate "APDS990X combined als and proximity sensors"
	 depends on I2C
	 default n
	 ---help---
	   Say Y here if you want to build a driver for Avago APDS990x
	   combined ambient light and proximity sensor chip.

	   To compile this driver as a module, choose M here: the
	   module will be called apds990x. If unsure, say N here.

config HMC6352
	tristate "Honeywell HMC6352 compass"
	depends on I2C
	help
	  This driver provides support for the Honeywell HMC6352 compass,
	  providing configuration and heading data via sysfs.

config SENSORS_AK8975
	tristate "AK8975 compass support"
	default n
	depends on I2C
	help
	  If you say yes here you get support for Asahi Kasei's
	  orientation sensor AK8975.

config DS1682
	tristate "Dallas DS1682 Total Elapsed Time Recorder with Alarm"
	depends on I2C && EXPERIMENTAL
	help
	  If you say yes here you get support for Dallas Semiconductor
	  DS1682 Total Elapsed Time Recorder.

	  This driver can also be built as a module.  If so, the module
	  will be called ds1682.

config TI_DAC7512
	tristate "Texas Instruments DAC7512"
	depends on SPI && SYSFS
	help
	  If you say yes here you get support for the Texas Instruments
	  DAC7512 16-bit digital-to-analog converter.

	  This driver can also be built as a module. If so, the module
	  will be called ti_dac7512.

config UID_STAT
	bool "UID based statistics tracking exported to /proc/uid_stat"
	default n

config BMP085
	tristate "BMP085 digital pressure sensor"
	depends on I2C && SYSFS
	help
	  If you say yes here you get support for the Bosch Sensortec
	  BMP085 digital pressure sensor.

	  To compile this driver as a module, choose M here: the
	  module will be called bmp085.

config BMP180
        tristate "BMP180 digital pressure sensor"
        depends on I2C && SYSFS
        help
          If you say yes here you get support for the Bosch Sensortec
          BMP180 digital pressure sensor.

          To compile this driver as a module, choose M here: the
          module will be called bmp180.

config WL127X_RFKILL
	tristate "Bluetooth power control driver for TI wl127x"
	depends on RFKILL
	default n
	---help---
	 Creates an rfkill entry in sysfs for power control of Bluetooth
	 TI wl127x chips.

config APANIC
	bool "Android kernel panic diagnostics driver"
	default n
	---help---
	 Driver which handles kernel panics and attempts to write
	 critical debugging data to flash.

config APANIC_PLABEL
	string "Android panic dump flash partition label"
	depends on APANIC
	default "kpanic"
	---help---
	 If your platform uses a different flash partition label for storing
 	 crashdumps, enter it here.

config USB_SWITCH_FSA9480
	tristate "FSA9480 USB Switch"
	depends on I2C
	help
	  The FSA9480 is a USB port accessory detector and switch.
	  The FSA9480 is fully controlled using I2C and enables USB data,
	  stereo and mono audio, video, microphone and UART data to use
	  a common connector port.

config USB_SWITCH_FSA9480_DISABLE_OTG
	bool "Disable functions associated with OTG"
	depends on USB_SWITCH_FSA9480
	default n

config SEC_30PIN_CON
	bool "Samsung 30-pin connector support for tablet devices"
	help
	  This feature add an infratructure to control and detecting 30-pin
	  connector for Samsung Tablet devices. Many optional devices can be
	  connected throu out this connector for example TA/USB/DOCK etc. to
	  support accessary devices for Samsunt Tablet device this feature
	  must be enabled.

config OMAP_DIE_TEMP_SENSOR
        bool "OMAP On-Die temp sensor support"
        depends on OMAP_TEMP_SENSOR
        help
          Enabling this config will give support for the on-die
          temp sensor for the OMAP platform.

config OMAP_4430_TEMP_SENSOR
	bool "OMAP On-Die Bandgap temp sensor support"
	depends on OMAP_TEMP_SENSOR
	default n

config LEDS_AN30259A
        tristate "LED driver for panasonic AN30259A RGB LED"
        depends on I2C
        help
          This option enables support for AN30259A RGB LED chips
          accessed via the I2C bus.
          AN30259A has three channel LED driver. By synchronous clock
          function, combined operation is possible.

config OMAP4_DUTY_CYCLE_LEGACY
	tristate "Control OPP_NITRO based on duty cycle strategy (LEGACY)"
	depends on ARCH_OMAP4
	default n
	---help---
	This could have high level of leakage which could pontentially sustain a thermal runaway.

config MPU_333_ENABLE
	bool "Mpu gyro sensor MPL 4.1.1"
	depends on I2C
	default n

config FACTORY_PBA_JACK_TEST_SUPPORT
	bool "Samsung factory pba jack test"
	default n

config JACK_RESELECTOR_SUPPORT
	bool "Samsung jack reselector control"
	default n

config TWL6040_VIB
	bool "TWL6040 Vibrator"
	depends on TWL6040_CODEC && ANDROID_TIMED_OUTPUT
	default n

config CDC_TCXO
       tristate "Texas Instruments CDC TCXO"
       depends on I2C
       default n
       help
         Enable support for Texas Instruments CDC TCXO CDC3S04

source "drivers/misc/c2port/Kconfig"
source "drivers/misc/eeprom/Kconfig"
source "drivers/misc/inv_mpu/Kconfig"
source "drivers/misc/iwmc3200top/Kconfig"
source "drivers/misc/ti-st/Kconfig"
source "drivers/misc/lis3lv02d/Kconfig"
source "drivers/misc/modem_if/Kconfig"
source "drivers/misc/modem_if_v2/Kconfig"
source "drivers/misc/mpu3050/Kconfig"
source "drivers/misc/gcx/gccore/Kconfig"
source "drivers/misc/gcx/gcioctl/Kconfig"
source "drivers/misc/gcx/gcbv/Kconfig"
source "drivers/misc/cache-2dmanager/Kconfig"

endif # MISC_DEVICES
```

## drivers/net/wimax/Kconfig
```kconfig
#
# WiMAX LAN device drivers configuration
#

if WIMAX

menu "WiMAX Wireless Broadband devices"

source "drivers/net/wimax/i2400m/Kconfig"

endmenu

endif
```

## drivers/staging/Kconfig
```kconfig
menuconfig STAGING
	bool "Staging drivers"
	default n
	---help---
	  This option allows you to select a number of drivers that are
	  not of the "normal" Linux kernel quality level.  These drivers
	  are placed here in order to get a wider audience to make use of
	  them.  Please note that these drivers are under heavy
	  development, may or may not work, and may contain userspace
	  interfaces that most likely will be changed in the near
	  future.

	  Using any of these drivers will taint your kernel which might
	  affect support options from both the community, and various
	  commercial support organizations.

	  If you wish to work on these drivers, to help improve them, or
	  to report problems you have with them, please see the
	  driver_name.README file in the drivers/staging/ directory to
	  see what needs to be worked on, and who to contact.

	  If in doubt, say N here.

if STAGING

source "drivers/staging/generic_serial/Kconfig"

source "drivers/staging/cx25821/Kconfig"

source "drivers/staging/tm6000/Kconfig"

source "drivers/staging/usbip/Kconfig"

source "drivers/staging/winbond/Kconfig"

source "drivers/staging/wlan-ng/Kconfig"

source "drivers/staging/brcm80211/Kconfig"

source "drivers/staging/comedi/Kconfig"

source "drivers/staging/olpc_dcon/Kconfig"

source "drivers/staging/asus_oled/Kconfig"

source "drivers/staging/rtl8712/Kconfig"

source "drivers/staging/frontier/Kconfig"

source "drivers/staging/android/Kconfig"

source "drivers/staging/pohmelfs/Kconfig"

source "drivers/staging/line6/Kconfig"

source "drivers/staging/serqt_usb2/Kconfig"

source "drivers/staging/quatech_usb2/Kconfig"

source "drivers/staging/vt6656/Kconfig"

source "drivers/staging/iio/Kconfig"

source "drivers/staging/lz4/Kconfig"

source "drivers/staging/snappy/Kconfig"

source "drivers/staging/zram/Kconfig"

source "drivers/staging/zcache/Kconfig"

source "drivers/staging/sm7xx/Kconfig"

source "drivers/staging/msm/Kconfig"

source "drivers/staging/lirc/Kconfig"

source "drivers/staging/easycap/Kconfig"

source "drivers/staging/tidspbridge/Kconfig"

source "drivers/staging/westbridge/Kconfig"

source "drivers/staging/ath6kl/Kconfig"

source "drivers/staging/keucr/Kconfig"

source "drivers/staging/bcm/Kconfig"

source "drivers/staging/ft1000/Kconfig"

source "drivers/staging/speakup/Kconfig"

source "drivers/staging/cptm1217/Kconfig"

source "drivers/staging/ste_rmi4/Kconfig"

source "drivers/staging/altera-stapl/Kconfig"

source "drivers/staging/secvib/Kconfig.sec"

source "drivers/staging/thermal_framework/Kconfig"

source "drivers/staging/omaprpc/Kconfig"

source "drivers/staging/sec_irled/Kconfig"

endif # STAGING
```

## drivers/staging/ft1000/Kconfig
```kconfig
config FT1000
	tristate "Drivers for Flarion ft1000 devices"

if FT1000

config FT1000_USB
	tristate "Driver for ft1000 usb devices."
	depends on USB
	depends on NET
	help
	  Say Y if you want to have support for Qleadtek FLASH-OFDM USB Modem [LR7F04],
	  Qleadtek Express Card or Leadtek Multi-band modem HSDPA.

endif
```

## drivers/staging/lz4/Kconfig
```kconfig
config LZ4_COMPRESS
	tristate "LZ4 Compression"
	default n
	help
		LZ4 is a lossless data compression algorithm that is focused on compression and decompression speed.
		The algorithm gives a slightly worse compression ratio than the LZO algorithm.
		However, compression speeds are similar to LZO, and several times faster than other algorithms.
		In a worst case scenario, incompressible data gets increased by 0.4%.

config LZ4_DECOMPRESS
	tristate "LZ4 Decompression"
	default n
	help
		LZ4 is a lossless data compression algorithm that is focused on compression and decompression speed.
		The algorithm gives a decompression speeds that can be up to three times that of LZO.
```
